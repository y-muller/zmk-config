## config/west.yml
```yaml
manifest:
  remotes:
    - name: zmkfirmware
      url-base: https://github.com/zmkfirmware
    # Additional modules containing boards/shields/custom code can be listed here as well
    # See https://docs.zephyrproject.org/3.2.0/develop/west/manifest.html#projects
    - name: petejohanson
      url-base: https://github.com/petejohanson
    - name: eyelash
      url-base: https://github.com/a741725193
  projects:
    - name: zmk
      remote: petejohanson
      revision: feat/pointers-with-input-processors
      import: app/west.yml
    - name: zmk-new_corne
      remote: eyelash
      revision: main
  self:
    path: config
```
