/ {
    macros {
        // Single Alt-tab to swap to the previous window instead of cycling through
        priv_cemail: priv_cemail {
            compatible = "zmk,behavior-macro";
            #binding-cells = <0>;
            bindings = 
                <&macro_tap &kp A &kp AT &kp B &kp DOT &kp C>;
        };
        priv_comp: priv_comp {
            compatible = "zmk,behavior-macro";
            #binding-cells = <0>;
            bindings = 
                <&macro_tap &kp C &kp O &kp B &kp M &kp P>;
        };
   };
};
